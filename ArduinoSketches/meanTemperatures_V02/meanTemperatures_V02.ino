// historic data
const float meansT[] = {0.43, 0.60, 1.13, 1.01, 1.10, 0.54, 0.33, 0.21, -0.05, -0.10, -0.27, -0.14, -0.62,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 1.31, 0.98};

// 2018 data
const float means2018[] = {5.3, 5.5, 4.5, 7.7, 8.0, 5.6, 7.3, 5.2, 6.3, 4.3, 4.8, 4.7, 1.3,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 4.3, 5.1};

// this variables will save min and max temperature deviation
float maxT = 0;
float minT = 0;

void setup() 
{ 
  Serial.begin(9600);
}

void loop() 
{}

void PrintValues ()
{
  Serial.println("Number of entries of 30 year averages: ");
  Serial.println(sizeof(meansT) / 4 + 1);
  Serial.println("***************************************");

  int steps = sizeof(means2018) / 4 + 1; // number of comparisons we want to make make
  // sizeof returns bytes. one float is 4 bytes: divide by 4 to get entries count.

  Serial.println("Number of entries of recent data: ");
  Serial.println(sizeof(steps));
  Serial.println("***************************************");

  int index = 0; //startDay; // index we start reading from meansT from
  while (index < 365) { // step through temperature information

    float historicT = means2018[index]; // pgm_read_float(&means2018[index]);
    float recentT = meansT[index]; // pgm_read_float(&meansT[index]);

    float diff = recentT - historicT;

    Serial.print(index);
    Serial.print(": ");
    Serial.println(diff);

    maxT = max(diff, maxT);
    minT = min(diff, minT);

    index = index + 1;
    yield();
  }

  Serial.println("min & max differences");
  Serial.print(minT);
  Serial.print(", ");
  Serial.println(maxT);
}

float GetDifference(unsigned short index)
{
  return meansT[index] - means2018[index];
}

float GetDifference(byte day, byte month)
{
  unsigned short index = IndexFromDate(day, month);

  return meansT[index] - means2018[index];
}

unsigned int IndexFromDate(byte day, byte month)
{
  month--; day--;

  unsigned int idx = day;
  if (month > 0) day += 31;
  if (month > 1) day += 28;
  if (month > 2) day += 31;
  if (month > 3) day += 30;
  if (month > 4) day += 31;
  if (month > 5) day += 30;
  if (month > 6) day += 31;
  if (month > 7) day += 31;
  if (month > 8) day += 30;
  if (month > 9) day += 31;
  if (month > 10) day += 30;

  idx = constrain(idx, 0, 364);

  return idx;
}
